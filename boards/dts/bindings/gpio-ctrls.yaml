## boards/dts/bindings/gpio-ctrls.yaml
```yaml
# Copyright (c) 2018, Linaro Limited
# SPDX-License-Identifier: Apache-2.0

description: GPIO controls parent node

compatible: "gpio-ctrls"

child-binding:
    description: GPIO control child node
    properties:
       gpios:
          type: phandle-array
          required: true
       label:
          required: true
          type: string
          description: Human readable string describing the device (used by Zephyr for API name)
```

## peripheral_uart_adc/boards/arm/ebshsnzwz_nrf52832/Kconfig.defconfig
```kconfig
# EBSHSNZWZ NRF52832 board configuration

# Copyright (c) 2016 Nordic Semiconductor ASA
# SPDX-License-Identifier: Apache-2.0

if BOARD_EBSHSNZWZ_NRF52832

config BOARD
	default "ebshsnzwz_nrf52832"

config BT_CTLR
	default BT

endif # BOARD_EBSHSNZWZ_NRF52832
```

## peripheral_uart_adc/boards/dts/bindings/gpio-adccs.yaml
```yaml
# Copyright (c) 2019, Peter Bigot Consulting, LLC
# SPDX-License-Identifier: Apache-2.0

description: ADC channels configuration

compatible: "gpio-adccs"

child-binding:
    description: ADC channel child node
    properties:
       channel:
          type: int
          required: true
       label:
          required: true
          type: string
          description: Human readable string describing the device (used by Zephyr for API name)
```
